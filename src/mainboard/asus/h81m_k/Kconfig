## src/mainboard/asus/h81m_k/Kconfig
```kconfig
## SPDX-License-Identifier: GPL-2.0-only

if BOARD_ASUS_H81M_K

config BOARD_SPECIFIC_OPTIONS
	def_bool y
	select BOARD_ROMSIZE_KB_8192
	select HAVE_ACPI_RESUME
	select HAVE_ACPI_TABLES
	select NORTHBRIDGE_INTEL_HASWELL
	select SERIRQ_CONTINUOUS_MODE
	select SOUTHBRIDGE_INTEL_LYNXPOINT

config MAINBOARD_DIR
	string
	default "asus/h81m_k"

config MAINBOARD_PART_NUMBER
	string
	default "H81M-K"

config USBDEBUG_HCD_INDEX # FIXME: check this
	int
	default 2
endif
```
